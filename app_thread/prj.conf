## CMakeLists.txt
```
cmake_minimum_required(VERSION 3.20.0)
set(DTC_OVERLAY_FILE "boards/thread.overlay")
find_package(Zephyr REQUIRED HINTS $ENV{ZEPHYR_BASE})
project(app_thread)
target_sources(app PRIVATE src/main.c)
```

## sample.yaml
```
sample:
  name: Kernel Thread Example
  description: Demonstrates creating and managing multiple Zephyr kernel threads
tests:
  sample.app.thread:
    tags:
      - threads
      - kernel
      - gpio
      - LED
    filter: dt_enabled_alias_with_parent_compat("led0", "gpio-leds")
    depends_on: gpio
    harness: console
    harness_config:
      type: multi_line
      regex:
        - "Message from log thread"
```

## prj.conf
```kconfig
CONFIG_LOG=y
CONFIG_GPIO=y
CONFIG_THREAD_RUNTIME_STATS=y
```

## boards/thread.overlay
```dts
/{
    aliases{
        led0 = &greenled;
    };

    leds{
        compatiple="gpio-leds";

        greenled:led0
        {
            gpios = <&gpioa 5 GPIO_ACTIVE_HIGH>;
        };
    };
};
```

## src/main.c
```c
#include <stdint.h>
#include <zephyr/kernel.h>
#include <zephyr/kernel/thread.h>
#include <zephyr/drivers/gpio.h>
#include <zephyr/logging/log.h>

#define LED_NODE                      DT_ALIAS(led0)
/* Create Log thread Macro */
#define LOG_THREAD_STACK_SIZE         512
#define LOG_THREAD_PRIORITY           1
/* Create LED thread Macro */
#define LED_THREAD_STACK_SIZE         512
#define LED_THREAD_PRIORITY           2

LOG_MODULE_REGISTER(app_thread, CONFIG_LOG_DEFAULT_LEVEL);

static const struct gpio_dt_spec led = GPIO_DT_SPEC_GET(LED_NODE, gpios);

K_THREAD_STACK_DEFINE(led_thread_stack, LED_THREAD_STACK_SIZE);
K_THREAD_STACK_DEFINE(log_thread_stack, LOG_THREAD_STACK_SIZE);

struct k_thread led_thread_data; 
struct k_thread log_thread_data; 
k_thread_runtime_stats_t rt_led_stats_thread;
k_thread_runtime_stats_t rt_log_stats_thread;


/**
 * TODO: Create a Blinking Thread
 */
void led_blink_thread(void *arg1, void *arg2, void* arg3)
{

    while(1)
    {
        gpio_pin_toggle_dt(&led);
        k_thread_runtime_stats_get(k_current_get(), &rt_led_stats_thread);
        LOG_INF("Cycle LOG: %llu", rt_led_stats_thread.execution_cycles);
        k_msleep(20);
    }
    
}


/**
 * TODO: Create a print Log Thread
 */
void log_print_thread(void *arg1, void *arg2, void *arg3)
{
  

    while(1)
    {
        k_thread_runtime_stats_get(k_current_get(), &rt_log_stats_thread);
        LOG_INF("Cycle LED: %llu", rt_log_stats_thread.execution_cycles);
        k_msleep(20);
    }
}

int main(void)
{

    int8_t ret = 0;

    /*
     * Configure the LED pin as output and check if it's succeed or not  
     */
    ret = gpio_pin_configure_dt(&led, GPIO_OUTPUT);
    if(ret != 0)
    {
        LOG_ERR("Config port %s pin %d as output failed", led.port->name, led.pin);
    }

    /*
    * Create LED thread 
    */
    k_thread_create(&led_thread_data, 
                    led_thread_stack,
                    LED_THREAD_STACK_SIZE, 
                    led_blink_thread, 
                    NULL, NULL, NULL, 
                    LED_THREAD_PRIORITY, 
                    0, 
                    K_NO_WAIT);
        
    /*
    * Create LOG thread 
    */
    k_thread_create(&log_thread_data, 
                    log_thread_stack,
                    LOG_THREAD_STACK_SIZE, 
                    log_print_thread,
                    NULL, NULL, NULL,
                    LOG_THREAD_PRIORITY, 
                    0,
                    K_NO_WAIT);
                    
    // Run forever
    while(1)
    {
        k_sleep(K_FOREVER);
    }
    return 0; 
}
```
