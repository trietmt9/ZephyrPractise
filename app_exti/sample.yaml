## app_exti/sample.yaml
```yaml
sample:
  name: External Interrupt Example
  description: External interrupt (EXTI) handling with GPIO callbacks
tests:
  sample.app.exti:
    tags:
      - gpio
      - interrupt
      - button
    filter: dt_enabled_alias_with_parent_compat("mybtn", "gpio-keys")
    depends_on: gpio
    harness: console
    harness_config:
      type: multi_line
      regex:
        - "Button|Interrupt"
```

## app_msg_queue/sample.yaml
```yaml
sample:
  name: Kernel Message Queue Example
  description: Environmental monitoring system demonstrating message queue usage for sensor data collection
tests:
  sample.app.msgqueue:
    tags:
      - msgqueue
      - threads
      - kernel
      - synchronization
      - sensors
    harness: console
    harness_config:
      type: multi_line
      regex:
        - "Environmental Monitoring System"
        - "Temperature sensor thread started"
        - "Humidity sensor thread started"
        - "Pressure sensor thread started"
        - "Data logger thread started"
        - "\\[LOG\\].*Temperature:.*°C"
        - "\\[LOG\\].*Humidity:.*%"
        - "\\[LOG\\].*Pressure:.*hPa"
        - "Statistics.*Total processed"
```

## app_mutex/sample.yaml
```yaml
sample:
  name: Kernel Mutex Example
  description: Demonstrates mutex usage for protecting shared resources between threads
tests:
  sample.app.mutex:
    tags:
      - mutex
      - threads
      - kernel
      - synchronization
    harness: console
    harness_config:
      type: multi_line
      regex:
        - "Thread.*started"
        - "Thread.*finished"
        - "RACE CONDITION DETECTED|SUCCESS"
```

## app_sem/sample.yaml
```yaml
sample:
  name: Kernel Semaphore Example
  description: Demonstrates semaphore usage for signaling, resource management, and producer-consumer pattern
tests:
  sample.app.semaphore:
    tags:
      - semaphore
      - threads
      - kernel
      - synchronization
      - producer-consumer
    harness: console
    harness_config:
      type: multi_line
      regex:
        - "Binary Semaphore.*Signaling"
        - "Counting Semaphore.*Resource Pool"
        - "Producer-Consumer Pattern"
        - "Producer:.*item"
        - "Consumer:.*item"
```

## app_spi/sample.yaml
```yaml
sample:
  name: SPI Device Driver Example
  description: Demonstrates SPI communication with custom driver abstraction, including write, read, and full-duplex transfer operations
tests:
  sample.app.spi:
    tags:
      - spi
      - driver
      - communication
    filter: dt_nodelabel_enabled("spi1")
    depends_on: spi
    harness: console
    harness_config:
      type: multi_line
      regex:
        - "SPI initialized successfully"
        - "Transfer test passed"
```

## app_timer/sample.yaml
```yaml
sample:
  name: Kernel Timer Example
  description: Demonstrates Zephyr kernel timers for periodic tasks
tests:
  sample.app.timer:
    tags:
      - timer
      - kernel
    harness: console
    harness_config:
      type: multi_line
      regex:
        - "Timer"
```
