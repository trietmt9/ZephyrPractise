## CMakeLists.txt
```
cmake_minimum_required(VERSION 3.20.0)
set(DTC_OVERLAY_FILE "boards/helloworld.overlay")
find_package(Zephyr REQUIRED HINTS $ENV{ZEPHYR_BASE})
project(app_hello_world)
target_sources(app PRIVATE src/main.c)
```

## sample.yaml
```
sample:
  name: Hello World with Logging
  description: Basic Hello World application demonstrating printk and logging subsystem
tests:
  sample.app.helloworld:
    tags:
      - logging
      - console
    harness: console
    harness_config:
      type: multi_line
      ordered: false
      regex:
        - "Hello World sent using printk"
        - "Helloworld sent using Log INFO level"
```

## prj.conf
```kconfig
CONFIG_PRINTK=y
CONFIG_LOG=y
```

## boards/helloworld.overlay
```dts
/ {
	
};
```

## src/main.c
```c
#include <zephyr/kernel.h>
#include <zephyr/sys/printk.h>
#include <zephyr/logging/log.h>
#define TRANSMIT_PERIOD_MS 500
/*
*@NOTE: CONFIG_LOG_MAX_LEVEL: will also include Debug level log 
*/
LOG_MODULE_REGISTER(app_helloworld, CONFIG_LOG_MAX_LEVEL);

/*
*@NOTE: CONFIG_LOG_DEFAULT_LEVEL: will not include DEbug level initialy 
*/
int main(void)
{
	printk("Hello World sent using printk()\n");
	LOG_INF("Helloworld sent using Log INFO level");
	LOG_DBG("Helloworld sent using Log DEBUG level");
	LOG_WRN("Helloworld sent using Log WARNING level");
	LOG_ERR("Helloworld sent using Log ERROR level");
	return 0;
}
```
